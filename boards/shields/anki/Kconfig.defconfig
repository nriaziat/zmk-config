## boards/shields/anki/Kconfig.defconfig
```kconfig
if SHIELD_ANKI

# Name must be less than 16 characters long!
config ZMK_KEYBOARD_NAME
    default "Anki"

endif
```

## boards/shields/anki/Kconfig.shield
```kconfig
# No whitespace after the comma or in your keyboard name!
config SHIELD_ANKI
    def_bool $(shields_list_contains,anki)
```

## config/west.yml
```yaml
manifest:
  remotes:
    - name: zmkfirmware
      url-base: https://github.com/zmkfirmware
    # Additional modules containing boards/shields/custom code can be listed here as well
    # See https://docs.zephyrproject.org/3.2.0/develop/west/manifest.html#projects
    - name: module_a_base
      url-base: https://github.com/nriaziat/anki-shield
  projects:
    - name: zmk
      remote: zmkfirmware
      revision: main
      import: app/west.yml
  self:
    path: config
```
