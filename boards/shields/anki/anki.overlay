#include <dt-bindings/zmk/matrix_transform.h> // Put this with the other includes at the top of your overlay
#include "my_keyboard-layouts.dtsi"

/ {
    chosen {
        zmk,kscan = &kscan0;
        zmk,physical-layout = &physical_layout0;
    };
    default_transform: keymap_transform0 {
        compatible = "zmk,matrix-transform";
        columns = <5>; // Length of the "col-gpios" array
        rows = <1>; // Length of the "row-gpios" array
        map = <
        //   Key 1 | Key 2 | Key 3...
            RC(0,0) RC(0,1) RC(0,2) RC(0,3) RC(0,4)
        >;
    };
    kscan0: kscan {
        compatible = "zmk,kscan-gpio-direct";
        wakeup-source;
        input-gpios
            = <&gpio0 6 (GPIO_ACTIVE_LOW | GPIO_PULL_UP)>
            , <&gpio0 17 (GPIO_ACTIVE_LOW | GPIO_PULL_UP)>
            , <&gpio0 20 (GPIO_ACTIVE_LOW | GPIO_PULL_UP)>
            , <&gpio0 22 (GPIO_ACTIVE_LOW | GPIO_PULL_UP)>
            , <&gpio0 24 (GPIO_ACTIVE_LOW | GPIO_PULL_UP)>
            ;
    };
};
